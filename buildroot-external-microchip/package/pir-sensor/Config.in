## buildroot-external-microchip/package/pir-sensor/Config.in
```kconfig
config BR2_PACKAGE_PIR_SENSOR
	bool "pir_sensor"
	depends on BR2_LINUX_KERNEL
	help
	  Includes the packge responsibe for building kernel module for PIR motion sensor
```
